## sensor_broadcaster/lightranger9_oot_driver/zephyr/Kconfig
```kconfig
# MikroE LightRanger9 Time of Flight Sensor

config LIGHTRANGER9
    bool "LightRanger9 time of Flight sensor"
    depends on I2C
    help
      Enable driver for LightRanger9 (TMF8828) time of flight sensor.
```

## sensor_broadcaster/lightranger9_oot_driver/zephyr/dts/bindings/mikroe,lightranger9.yaml
```yaml
#
# Copyright 2023 u-blox Ltd
# 
# Apache License, Version 2.0
# http://www.apache.org/licenses/LICENSE-2.0

description: MikroE LightRanger9 (TMF8828) Time Of Flight sensor

compatible: "mikroe,lightranger9"

include: i2c-device.yaml

properties:
  control-gpios:
    type: phandle-array
    required: true
    description:
      Pin on which sensor data will be read from.
```
